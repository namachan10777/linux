## drivers/lambda/Kconfig
```kconfig
# SPDX-License-Identifier: GPL-2.0-only
#
# FPGA framework configuration
#

menuconfig LAMBDA
	tristate "Lambda calc"
	help
	  Say Y!
```

## drivers/unrandom/Kconfig
```kconfig
# SPDX-License-Identifier: GPL-2.0-only
#
# FPGA framework configuration
#

menuconfig UNRANDOM
	tristate "Unrandom seed"
	help
	  unrandom seed generator
```
